## components/golioth_sdk/Kconfig
```kconfig
menu "Golioth SDK Configuration"

config GOLIOTH_COAP_HOST_URI
    string "CoAP server URI"
    default "coaps://coap.golioth.io"
    help
        The URI of the CoAP server

config GOLIOTH_COAP_RESPONSE_TIMEOUT_MS
    int "CoAP response timeout"
    default 10000
    help
        Maximum time, in milliseconds, the CoAP task will block while waiting
        for a response from the server.

config GOLIOTH_COAP_REQUEST_QUEUE_TIMEOUT_MS
    int "CoAP request queue timeout"
    default 1000
    help
        Maximum time, in milliseconds, the CoAP task will block while
        waiting for something to arrive in the request queue.
        This is also how often to poll for received observations.

config GOLIOTH_COAP_REQUEST_QUEUE_MAX_ITEMS
    int "CoAP request queue max num items"
    default 20
    help
        The size, in items, of the CoAP task request queue.
        If the queue is full, any attempts to queue new messages
        will fail.

config GOLIOTH_COAP_TASK_PRIORITY
    int "Golioth CoAP task priority"
    default 5
    help
        FreeRTOS task priority of the Golioth CoAP task.

config GOLIOTH_COAP_TASK_STACK_SIZE_BYTES
    int "Golioth CoAP task stack size"
    default 8192
    help
        FreeRTOS task stack size of the Golioth CoAP task, in bytes.

config GOLIOTH_COAP_KEEPALIVE_INTERVAL_MS
    int "Golioth CoAP keepalive interval, in milliseconds"
    default 0
    help
        How often to send a "keepalive" dummy client request to the server.
        If the session is idle for this amount of time, then the keepalive
        request will be sent.
        Can be useful to keep the CoAP session active, and to mitigate
        against NAT and server timeouts.
        Set to 0 to disable.

config GOLIOTH_MAX_NUM_OBSERVATIONS
    int "Golioth CoAP maximum number observations"
    default 8
    help
        The maximum number of CoAP paths which can be simultaneously observed.

endmenu
```

## example/main/Kconfig
```kconfig
menu "Golioth Application Configuration"

config GOLIOTH_EXAMPLE_COAP_PSK_ID
    string "CoAP PSK ID"
    default "deviceid@project"
    help
        The pre-shared key ID to use when connecting
        to the CoAP server over DTLS

config GOLIOTH_EXAMPLE_COAP_PSK
    string "CoAP PSK"
    default "supersecret"
    help
        The pre-shared key to use when connecting
        to the CoAP server over DTLS

endmenu
```

## examples/coap_minimal/sdkconfig.defaults
```kconfig
CONFIG_MBEDTLS_SSL_PROTO_DTLS=y
CONFIG_MBEDTLS_PSK_MODES=y
CONFIG_MBEDTLS_KEY_EXCHANGE_PSK=y
CONFIG_LWIP_NETBUF_RECVINFO=y

CONFIG_ESP_COREDUMP_ENABLE_TO_UART=y
CONFIG_ESP_SYSTEM_PANIC_PRINT_HALT=y
CONFIG_LOG_DEFAULT_LEVEL_DEBUG=y
```

## examples/golioth_basics/sdkconfig.defaults
```kconfig
CONFIG_MBEDTLS_SSL_PROTO_DTLS=y
CONFIG_MBEDTLS_PSK_MODES=y
CONFIG_MBEDTLS_KEY_EXCHANGE_PSK=y
CONFIG_LWIP_NETBUF_RECVINFO=y
CONFIG_FREERTOS_USE_TRACE_FACILITY=y
CONFIG_FREERTOS_USE_STATS_FORMATTING_FUNCTIONS=y
```

## examples/magtag_demo/main/Kconfig
```kconfig
menu "Golioth Application Configuration"

config GOLIOTH_EXAMPLE_WIFI_SSID
    string "WiFi SSID"
    default "myssid"
    help
        SSID of WiFi access point to connect to

config GOLIOTH_EXAMPLE_WIFI_PSK
    string "WiFi PSK/password"
    default "supersecret"
    help
        The pre-shared key of the WiFi AP (aka password)

config GOLIOTH_EXAMPLE_COAP_PSK_ID
    string "CoAP PSK ID"
    default "deviceid@project"
    help
        The pre-shared key ID to use when connecting
        to the CoAP server over DTLS

config GOLIOTH_EXAMPLE_COAP_PSK
    string "CoAP PSK"
    default "supersecret"
    help
        The pre-shared key to use when connecting
        to the CoAP server over DTLS

endmenu
```

## examples/ota/sdkconfig.defaults
```kconfig
CONFIG_MBEDTLS_SSL_PROTO_DTLS=y
CONFIG_MBEDTLS_PSK_MODES=y
CONFIG_MBEDTLS_KEY_EXCHANGE_PSK=y
CONFIG_LWIP_NETBUF_RECVINFO=y

# Default sdkconfig parameters to use the OTA
# partition table layout, with a 4MB flash size
CONFIG_ESPTOOLPY_FLASHSIZE_4MB=y
CONFIG_PARTITION_TABLE_TWO_OTA=y
```

## magtag/sdkconfig.defaults
```kconfig
CONFIG_MBEDTLS_SSL_PROTO_DTLS=y
CONFIG_MBEDTLS_PSK_MODES=y
CONFIG_MBEDTLS_KEY_EXCHANGE_PSK=y
CONFIG_LWIP_NETBUF_RECVINFO=y

# Refer to Adafruit schematic:
# https://cdn-learn.adafruit.com/assets/assets/000/096/946/original/adafruit_products_MagTag_sch.png?1605026160
CONFIG_EXAMPLE_RMT_TX_GPIO=1
CONFIG_EXAMPLE_STRIP_LED_NUMBER=4
```
